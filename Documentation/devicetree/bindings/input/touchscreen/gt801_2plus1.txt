## Documentation/devicetree/bindings/input/touchscreen/gt801_2plus1.txt
```
Device tree bindings for Goodix GT801 2+1 series touchscreen controller

Required properties:

 - compatible		: Should be "goodix,gt801_2plus1"
 - reg			: I2C address of the chip. Should be 0x55
 - interrupt-parent	: Interrupt controller to which the chip is connected
 - interrupts		: Interrupt to which the chip is connected

Example:

	i2c at 00000000 {
		/* ... */

		touchscreen at 55 {
			compatible = "goodix,gt801_2plus1";
			reg = <0x55>;
			interrupt-parent = <&gpio>;
			interrupts = <0 0>;
		};

		/* ... */
	};
```

## arch/arm/mach-s5l8930/Kconfig
```kconfig
menuconfig ARCH_S5L8930
	bool "Apple S5L8930"
	depends on ARCH_MULTI_V7
	select ARM_VIC
	select PLAT_SAMSUNG
	select CLKSRC_APPLE_S5L8930
	help
	  Apple S5L8930.
```
