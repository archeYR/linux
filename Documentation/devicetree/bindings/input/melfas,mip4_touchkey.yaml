## Documentation/devicetree/bindings/input/melfas,mip4_touchkey.yaml
```yaml
# SPDX-License-Identifier: (GPL-2.0-only OR BSD-2-Clause)
%YAML 1.2
---
$id: http://devicetree.org/schemas/input/melfas,mip4_touchkey.yaml#
$schema: http://devicetree.org/meta-schemas/core.yaml#

title: MELFAS MIP4 compatible touchkey driver

description: |
  MIP4 (MELFAS Interface Protocol v4) is a protocol developed by MELFAS. This
  driver implements support for MIP4 compatible touchkeys, such as the MHS
  series chips by MELFAS.

maintainers:
  - methanal <baclofen@tuta.io>

allOf:
  - $ref: input.yaml#

properties:
  compatible:
    const: melfas,mip4_touchkey

  reg:
    maxItems: 1

  interrupts:
    maxItems: 1

  vdd-supply:
    description: Power supply to the touchkey device

  linux,keycodes:
    description: Keycodes for the touchkeys

additionalProperties: false

required:
  - compatible
  - reg
  - interrupts

examples:
  - |
    #include <dt-bindings/input/input.h>
    #include <dt-bindings/interrupt-controller/irq.h>
    touchkey@49 {
      compatible = "melfas,mip4_touchkey";
      reg = <0x49>;
      interrupt-parent = <&gpio>;
      interrupts = <7 IRQ_TYPE_EDGE_FALLING>;
      vdd-supply = <&ldo>;
      linux,keycodes = <KEY_MENU KEY_BACK>;
    };

...
```
